/*
 * Copyright (c) 2026 BeagleBoard.org Foundation
 *
 * SPDX-License-Identifier: Apache-2.0
 */

/dts-v1/;

#include "beaglev_ahead.dts"

/ {
	model = "BeagleBoard.org BeagleV-Ahead (On-Chip SRAM 0xffe0000000)";

	chosen {
		zephyr,sram = &sram0;
		zephyr,ipc_shm = &ipc_shm0;
	};

	soc {
		ipc_shm0: memory@7f000000 {
			compatible = "mmio-sram";
			reg = <0x0 0x7f000000 0x0 DT_SIZE_K(64)>;
		};
	};
};
