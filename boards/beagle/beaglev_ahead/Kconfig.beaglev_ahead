## boards/beagle/beaglev_ahead/Kconfig.beaglev_ahead
```kconfig
# Copyright (c) 2026 BeagleV-Ahead Zephyr Port
# SPDX-License-Identifier: Apache-2.0

config BOARD_BEAGLEV_AHEAD
	select SOC_TH1520
	select QEMU_TARGET
```

## boards/beagle/beaglev_ahead/Kconfig.defconfig
```kconfig
# Copyright (c) 2026 BeagleV-Ahead Zephyr Port
# SPDX-License-Identifier: Apache-2.0

if BOARD_BEAGLEV_AHEAD

config BUILD_OUTPUT_BIN
	default y

config QEMU_ICOUNT
	default n

configdefault PRIVILEGED_STACK_SIZE
	default 2048

configdefault IDLE_STACK_SIZE
	default 1024 if SMP

endif # BOARD_BEAGLEV_AHEAD
```

## boards/beagle/beaglev_ahead/beaglev_ahead_th1520_opensbi_smp_defconfig
```kconfig
# SPDX-License-Identifier: Apache-2.0

CONFIG_CONSOLE=y
CONFIG_SERIAL=y
CONFIG_UART_CONSOLE=y
CONFIG_STACK_SENTINEL=y
CONFIG_XIP=n
CONFIG_RISCV_S_MODE=y
CONFIG_RISCV_S_MODE_EXTERNAL_SBI=y
CONFIG_SMP=y
CONFIG_MP_MAX_NUM_CPUS=4
CONFIG_QEMU_ICOUNT=n
CONFIG_PM_CPU_OPS=y
CONFIG_RISCV_SMP_IPI_SBI=y
```

## boards/beagle/beaglev_ahead/board.yml
```yaml
board:
  name: beaglev_ahead
  full_name: BeagleV-Ahead (T-Head TH1520)
  vendor: beagle
  socs:
    - name: th1520
      variants:
        - name: smp
        - name: smode
        - name: opensbi
        - name: opensbi_smp
```

## drivers/disk/Kconfig.dwcmshc
```kconfig
# Copyright (c) 2026 BeagleBoard.org Foundation
# SPDX-License-Identifier: Apache-2.0

config DISK_DRIVER_TH1520_DWCMSHC
	bool "T-Head TH1520 Synopsys DWC MSHC eMMC/SDHCI disk driver"
	default y
	depends on DT_HAS_THEAD_TH1520_DWCMSHC_ENABLED
	help
	  Enable block disk driver for the T-Head TH1520 Synopsys DesignWare
	  Mobile Storage Host Controller (mshc0 eMMC / mshc1 SDHCI).
```

## drivers/ethernet/Kconfig.th1520_gmac
```kconfig
# Copyright (c) 2026 BeagleBoard.org Foundation
# SPDX-License-Identifier: Apache-2.0

config ETH_TH1520_GMAC
	bool "T-Head TH1520 Synopsys DesignWare Gigabit Ethernet driver"
	default y
	depends on DT_HAS_THEAD_TH1520_GMAC_ENABLED
	help
	  Enable Ethernet driver for the T-Head TH1520 Synopsys DesignWare
	  Gigabit Ethernet MAC (gmac0 / gmac1) with RGMII APB clock glue and
	  Realtek RTL8211F PHY management.

if ETH_TH1520_GMAC

config ETH_NIC_MODEL
	string
	default "gmac0"

endif # ETH_TH1520_GMAC
```

## drivers/mbox/Kconfig.th1520
```kconfig
# Copyright (c) 2026 BeagleBoard.org Foundation
# SPDX-License-Identifier: Apache-2.0

config MBOX_TH1520
	bool "T-Head TH1520 Inter-Processor Mailbox driver"
	default y
	depends on DT_HAS_THEAD_TH1520_MBOX_ENABLED
	help
	  Enable driver for the T-Head TH1520 hardware mailbox controller
	  supporting multi-core AMP / RPMsg / OpenAMP inter-processor
	  signaling and 32-byte hardware message registers.
```

## drivers/pinctrl/Kconfig.th1520
```kconfig
# Copyright (c) 2026 BeagleBoard.org Foundation
# SPDX-License-Identifier: Apache-2.0

config PINCTRL_TH1520
	bool "T-Head TH1520 pin controller driver"
	default y
	depends on DT_HAS_THEAD_TH1520_PINCTRL_ENABLED
	help
	  Enable the T-Head TH1520 pad/pinmux controller driver for
	  PADCTRL_AOSYS, PADCTRL0_APSYS, and PADCTRL1_APSYS.
```

## drivers/pwm/Kconfig.th1520
```kconfig
# Copyright (c) 2026 BeagleBoard.org Foundation
# SPDX-License-Identifier: Apache-2.0

config PWM_TH1520
	bool "T-Head TH1520 PWM driver"
	default y
	depends on DT_HAS_THEAD_TH1520_PWM_ENABLED
	help
	  Enable driver for the T-Head TH1520 6-channel Pulse Width Modulation
	  (PWM) controller.
```

## drivers/rtc/Kconfig.xgene
```kconfig
# Copyright (c) 2026 BeagleBoard.org Foundation
# SPDX-License-Identifier: Apache-2.0

config RTC_XGENE
	bool "APM X-Gene / T-Head TH1520 DesignWare APB RTC driver"
	default y
	depends on DT_HAS_APM_XGENE_RTC_ENABLED
	help
	  Enable driver for the Synopsys DesignWare APB Real-Time Clock
	  (apm,xgene-rtc) used on APM X-Gene and T-Head TH1520 SoCs.
```

## drivers/sensor/moortec/Kconfig
```kconfig
# Copyright (c) 2026 BeagleBoard.org Foundation
# SPDX-License-Identifier: Apache-2.0

# zephyr-keep-sorted-start
source "drivers/sensor/moortec/mr75203/Kconfig"
# zephyr-keep-sorted-stop
```

## drivers/sensor/moortec/mr75203/Kconfig
```kconfig
# Copyright (c) 2026 BeagleBoard.org Foundation
# SPDX-License-Identifier: Apache-2.0

config MR75203
	bool "Moortec MR75203 On-Die PVT Sensor"
	default y
	depends on DT_HAS_MOORTEC_MR75203_ENABLED
	help
	  Enable driver for the Moortec MR75203 Process, Voltage, and
	  Temperature (PVT) monitor used on the T-Head TH1520 SoC.
```

## dts/bindings/cpu/thead,c910.yaml
```yaml
# Copyright (c) 2026 BeagleV-Ahead Zephyr Port
# SPDX-License-Identifier: Apache-2.0

description: T-Head XuanTie C910 64-bit RISC-V CPU

compatible: "thead,c910"

include: riscv-common.yaml
```

## dts/bindings/ethernet/thead,th1520-gmac.yaml
```yaml
# Copyright (c) 2026 BeagleBoard.org Foundation
# SPDX-License-Identifier: Apache-2.0

description: T-Head TH1520 Synopsys DesignWare Gigabit Ethernet MAC (DW_GMAC)

compatible: "thead,th1520-gmac"

include: [ethernet-controller.yaml, base.yaml]

properties:
  reg:
    required: true
    description: GMAC MMIO base address and TH1520 GMAC APB clock glue base address

  interrupts:
    required: true

  phy-addr:
    type: int
    default: 1
    description: MDIO PHY address of the external RGMII PHY (RTL8211F)
```

## dts/bindings/mbox/thead,th1520-mbox.yaml
```yaml
# Copyright (c) 2026 BeagleBoard.org Foundation
# SPDX-License-Identifier: Apache-2.0

description: T-Head TH1520 Inter-Processor Hardware Mailbox (MBOX)

compatible: "thead,th1520-mbox"

include: [mailbox-controller.yaml, base.yaml]

properties:
  reg:
    required: true
    description: Local CPU0 aperture and three remote ICU apertures (remote-icu0..2)

  interrupts:
    required: true

  "#mbox-cells":
    const: 1

mbox-cells:
  - channel
```

## dts/bindings/mmc/thead,th1520-dwcmshc.yaml
```yaml
# Copyright (c) 2026 BeagleBoard.org Foundation
# SPDX-License-Identifier: Apache-2.0

description: T-Head TH1520 Synopsys DesignWare Mobile Storage Host Controller (DWC MSHC eMMC/SDHCI)

compatible: "thead,th1520-dwcmshc"

include: base.yaml

properties:
  reg:
    required: true

  interrupts:
    required: true

  disk-name:
    type: string
    default: "EMMC"
    description: Disk name registered with Zephyr disk_access subsystem
```

## dts/bindings/pinctrl/thead,th1520-pinctrl.yaml
```yaml
# Copyright (c) 2026 BeagleBoard.org Foundation
# SPDX-License-Identifier: Apache-2.0

description: T-Head TH1520 Pad / Pinmux Controller (PADCTRL_AOSYS, PADCTRL0_APSYS, PADCTRL1_APSYS)

compatible: "thead,th1520-pinctrl"

include: base.yaml

properties:
  reg:
    required: true

  thead,pad-group:
    type: int
    required: true
    description: Pad controller group ID (1 = AOSYS, 2 = PADCTRL0_APSYS, 3 = PADCTRL1_APSYS)

child-binding:
  description: TH1520 pin configuration node
  include:
    - name: pincfg-node.yaml
      property-allowlist:
        - bias-disable
        - bias-pull-up
        - bias-pull-down
        - drive-strength
        - input-enable
        - input-schmitt-enable
  properties:
    pinmux:
      required: true
      type: int
      description: Encoded pinmux value created with TH1520_PINMUX(pin, func, padcfg)
```

## dts/bindings/pwm/thead,th1520-pwm.yaml
```yaml
# Copyright (c) 2026 BeagleBoard.org Foundation
# SPDX-License-Identifier: Apache-2.0

description: T-Head TH1520 6-channel PWM controller

compatible: "thead,th1520-pwm"

include: [pwm-controller.yaml, pinctrl-device.yaml, base.yaml]

properties:
  reg:
    required: true

  clock-frequency:
    type: int
    required: true
    description: Input clock frequency in Hz (typically 100 MHz on TH1520)

  "#pwm-cells":
    const: 3

pwm-cells:
  - channel
  - period
  - flags
```

## dts/bindings/rtc/apm,xgene-rtc.yaml
```yaml
# Copyright (c) 2026 BeagleBoard.org Foundation
# SPDX-License-Identifier: Apache-2.0

description: APM X-Gene / T-Head TH1520 Synopsys DesignWare APB Real-Time Clock (RTC)

compatible: "apm,xgene-rtc"

include: [rtc.yaml, base.yaml]

properties:
  reg:
    required: true

  interrupts:
    required: true
```

## dts/bindings/sensor/moortec,mr75203.yaml
```yaml
# Copyright (c) 2026 BeagleBoard.org Foundation
# SPDX-License-Identifier: Apache-2.0

description: Moortec MR75203 Process, Voltage, and Temperature (PVT) Sensor

compatible: "moortec,mr75203"

include: [sensor-device.yaml, base.yaml]

properties:
  reg:
    required: true
    description: Common, TS, PD, and VM register windows
```

## soc/thead/th1520/Kconfig
```kconfig
# Copyright (c) 2026 BeagleV-Ahead Zephyr Port
# SPDX-License-Identifier: Apache-2.0

config SOC_FAMILY_THEAD_TH1520
	select INCLUDE_RESET_VECTOR
	select RISCV
	select RISCV_PRIVILEGED
	select RISCV_SOC_HAS_GP_RELATIVE_ADDRESSING
	select ATOMIC_OPERATIONS_BUILTIN
	imply XIP
```

## soc/thead/th1520/Kconfig.defconfig
```kconfig
# Copyright (c) 2026 BeagleV-Ahead Zephyr Port
# SPDX-License-Identifier: Apache-2.0

if SOC_FAMILY_THEAD_TH1520

config RISCV_SOC_INTERRUPT_INIT
	default y

config 2ND_LVL_ISR_TBL_OFFSET
	default 12

config 2ND_LVL_INTR_00_OFFSET
	default 11

config 2ND_LEVEL_INTERRUPT_BITS
	default 9

config MAX_IRQ_PER_AGGREGATOR
	default 241

config NUM_IRQS
	default 253

config RISCV_HAS_PLIC
	default y

config INTC_INIT_PRIORITY
	default 30

config SYS_CLOCK_HW_CYCLES_PER_SEC
	default $(dt_node_int_prop_int,/cpus,timebase-frequency)

config SPI_DW_ACCESS_WORD_ONLY
	default y if SPI_DW

endif # SOC_FAMILY_THEAD_TH1520
```

## soc/thead/th1520/Kconfig.soc
```kconfig
# Copyright (c) 2026 BeagleV-Ahead Zephyr Port
# SPDX-License-Identifier: Apache-2.0

config SOC_FAMILY_THEAD_TH1520
	bool

config SOC_FAMILY
	default "thead_th1520" if SOC_FAMILY_THEAD_TH1520

config SOC_TH1520
	bool
	select SOC_FAMILY_THEAD_TH1520

config SOC
	default "th1520" if SOC_TH1520
```
